## boards/shields/jssplit/Kconfig.shield
```kconfig
config SHIELD_JSSPLIT_LEFT
    def_bool $(shields_list_contains,jssplit_left)
  
config SHIELD_JSSPLIT_RIGHT
    def_bool $(shields_list_contains,jssplit_right)
  
config SHIELD_JSSPLIT_DONGLE
    def_bool $(shields_list_contains,jssplit_dongle)
```

## config/west.yml
```yaml
manifest:
  defaults:
    revision: v0.3
  remotes:
    - name: zmkfirmware
      url-base: https://github.com/zmkfirmware
    #- name: petejohanson
    #  url-base: https://github.com/petejohanson
    - name: t0bybr
      url-base: https://github.com/t0bybr/
    - name: genteure
      url-base: https://github.com/Genteure  
    # Additional modules containing boards/shields/custom code can be listed here as well
    # See https://docs.zephyrproject.org/3.2.0/develop/west/manifest.html#projects
  projects:
    - name: zmk
      remote: zmkfirmware
      import: app/west.yml
    #- name: cirque-input-module
    #  remote: petejohanson
    #  revision: 0de55f36bc720b5be3d8880dc856d4d78baf5214
    #- name: pim447
    #  remote: t0bybr
    #  revision: main
    - name: zmk-driver-pim447
      remote: genteure
      revision: 38e1297f87c4a4306633356573ae8673dc7e9ecc
  self:
    path: config
```

## zmk-config-jssplit-w-WizardConfigv2/boards/shields/jssplit/Kconfig.defconfig
```kconfig
if SHIELD_JSSPLIT_LEFT

# Name must be less than 16 characters long!
config ZMK_KEYBOARD_NAME
    default "JSsplit"

config ZMK_SPLIT_ROLE_CENTRAL
    default y

config ZMK_SPLIT_BLE_CENTRAL_PERIPHERALS
  default 1

config BT_MAX_CONN
  default 6

config BT_MAX_PAIRED
  default 6

endif

if SHIELD_JSSPLIT_LEFT || SHIELD_JSSPLIT_RIGHT

config ZMK_SPLIT
    default y

config ZMK_POINTING
    default y

endif

if SHIELD_JSSPLIT_DONGLE

# Name must be less than 16 characters long!
config ZMK_KEYBOARD_NAME
    default "JSsplit"

config ZMK_POINTING
    default y

config ZMK_SPLIT
    default y

config ZMK_SPLIT_ROLE_CENTRAL
    default y

config ZMK_SPLIT_BLE_CENTRAL_PERIPHERALS
  default 2

config BT_MAX_CONN
  default 7

config BT_MAX_PAIRED
  default 7

endif

# ---------------------
# Kconfig for shield "jssplit_right" with board "nice_nano_v2"
# ---------------------
if BOARD_NICE_NANO_V2 && SHIELD_JSSPLIT_RIGHT

config I2C
    default y

endif
```
