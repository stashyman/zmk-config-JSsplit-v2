
/**
 * Generated by Shield Wizard for ZMK
 * Applies to shield "jssplit_right" with board "nice_nano_v2" only
 */

//
// ======== i2c0 ========
//

// pin control for i2c0
// - SDA on D2
// - SCL on D3
/*
&pinctrl {
    /* configuration for i2c0 device, default state */
    i2c0_default: i2c0_default {
        group1 {
            psels = <NRF_PSEL(TWIM_SDA, 0, 17)>,
                    <NRF_PSEL(TWIM_SCL, 0, 20)>;
            bias-pull-up;
        };
    };
    /* configuration for i2c0 device, sleep state */
    i2c0_sleep: i2c0_sleep {
        group1 {
            psels = <NRF_PSEL(TWIM_SDA, 0, 17)>,
                    <NRF_PSEL(TWIM_SCL, 0, 20)>;
            low-power-enable;
        };
    };
};
&i2c0 {
  //compatible = "nordic,nrf-twim";
  compatible = "nordic,nrf-twi";
  status = "okay";
  pinctrl-0 = <&i2c0_default>;
  pinctrl-1 = <&i2c0_sleep>;
  pinctrl-names = "default", "sleep";
  //clock-frequency = <I2C_BITRATE_FAST>;
  clock-frequency = <400000>;
};

// devices on i2c0
//input_device_right0: input_device_right0@2a
//found this in an input file of the PIM447 bindings from t0bybr module 
//  -- compatible: "zmk,pimoroni-pim447" (caused erroe when putting below)

&i2c0 {
    input_device_right0: input_device_right0@a {
        status = "okay";
        //compatible = "cirque,pinnacle";
        //reg = <0x2a>;
        //dr-gpios = <&gpio1 1 (GPIO_ACTIVE_LOW | GPIO_PULL_UP)>;
        //sleep;
        //no-secondary-tap;
        //no-taps;
        //sensitivity = "2x";
        //compatible = "pimoroni,pim447";
        //compatible = "zmk,pimoroni-pim447";
        compatible = "zephyr,input-device", "zmk,pimoroni-pim447";
        reg = <0x0A>;
        int-gpios = <&gpio1 1 (GPIO_ACTIVE_LOW | GPIO_PULL_UP)>;
        automouse-layer = <1>;
    };
};
*/